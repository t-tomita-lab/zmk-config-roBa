## config/west.yml
```yaml
manifest:
  remotes:
    - name: zmkfirmware
      url-base: https://github.com/zmkfirmware
    - name: kumamuk-git
      url-base: https://github.com/kumamuk-git
      # 以下を追加
    - name: kbrd-space
      url-base: https://github.com/kbrd-space
  projects:
    - name: zmk
      remote: zmkfirmware
      revision: v0.3-branch
      import: app/west.yml
    - name: zmk-pmw3610-driver
      remote: kumamuk-git
      revision: main
      # 以下を追加
    - name: zmk-anti-idle
      remote: kbrd-space
      revision: main
  self:
    path: config
```
